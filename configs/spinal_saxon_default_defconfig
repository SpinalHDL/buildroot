## configs/spinal_saxon_default_defconfig
```kconfig
# Compilation cache
BR2_CCACHE=y
BR2_CCACHE_DIR="$(HOME)/.buildroot-ccache-saxon_default"

# Target options
BR2_riscv=y
BR2_RISCV_32=y

# Instruction Set Extensions
BR2_riscv_custom=y
BR2_RISCV_ISA_CUSTOM_RVM=y
BR2_RISCV_ISA_CUSTOM_RVA=y
BR2_RISCV_ISA_CUSTOM_RVC=n
BR2_RISCV_ABI_ILP32=y

# GCC
BR2_GCC_VERSION_8_X=y
BR2_GCC_VERSION="8.3.0"

# System
BR2_TARGET_GENERIC_GETTY=y
BR2_TARGET_GENERIC_GETTY_PORT="hvc0"

# Filesystem
BR2_TARGET_ROOTFS_CPIO=y

# Net
BR2_SYSTEM_DHCP=""

#WIFI
BR2_PACKAGE_WPA_SUPPLICANT=y
BR2_PACKAGE_WPAN_TOOLS=y
BR2_PACKAGE_WPA_SUPPLICANT_NL80211=y
BR2_PACKAGE_WPA_SUPPLICANT_AP_SUPPORT=y
BR2_PACKAGE_WPA_SUPPLICANT_AUTOSCAN=y
BR2_PACKAGE_WPA_SUPPLICANT_HOTSPOT=y
BR2_PACKAGE_WPA_SUPPLICANT_WPS=y
BR2_PACKAGE_WPA_SUPPLICANT_CLI=y
BR2_PACKAGE_WPA_SUPPLICANT_PASSPHRASE=y
BR2_PACKAGE_WIRELESS_TOOLS=y

BR2_PACKAGE_HOSTAPD=y
BR2_PACKAGE_HOSTAPD_DRIVER_HOSTAP=y
BR2_PACKAGE_HOSTAPD_DRIVER_NL80211=y
BR2_PACKAGE_HOSTAPD_HAS_WIFI_DRIVERS=y
BR2_PACKAGE_LIBNL=y
BR2_PACKAGE_HOSTAPD_VLAN=y
BR2_PACKAGE_HOSTAPD_VLAN_DYNAMIC=y

# Linux headers
BR2_PACKAGE_HOST_LINUX_HEADERS_CUSTOM_5_0=y

# Kernel
BR2_LINUX_KERNEL=y
#BR2_LINUX_KERNEL_LATEST_VERSION=n
#BR2_LINUX_KERNEL_CUSTOM_VERSION=y
#BR2_LINUX_KERNEL_CUSTOM_VERSION_VALUE="5.0.9"
BR2_LINUX_KERNEL_USE_CUSTOM_CONFIG=y
BR2_LINUX_KERNEL_CUSTOM_CONFIG_FILE="board/spinal/saxon_default/linux.config"
BR2_LINUX_KERNEL_VMLINUX=y

# Rootfs customisation
BR2_ROOTFS_OVERLAY="board/spinal/saxon_default/rootfs_overlay"

# Extra packages
BR2_ECLIPSE_REGISTER=y
BR2_PACKAGE_DHRYSTONE=y
BR2_PACKAGE_MICROPYTHON=y
BR2_PACKAGE_PYTHON=n
BR2_PACKAGE_PYTHON_SPIDEV=n
BR2_PACKAGE_SL=y
BR2_PACKAGE_HELLO=y
BR2_PACKAGE_NANO=y

BR2_PACKAGE_LMBENCH=n
BR2_PACKAGE_RAMSPEED=n

BR2_GCC_CROSS_CXX=y
BR2_INSTALL_LIBSTDCPP=y
BR2_PACKAGE_IPERF=y
BR2_PACKAGE_IPERF3=y

BR2_PACKAGE_HTOP=y
BR2_PACKAGE_LYNX=n
BR2_PACKAGE_LINKS=n
```

## configs/spinal_saxon_ulx3s_defconfig
```kconfig
# Compilation cache
BR2_CCACHE=y
BR2_CCACHE_DIR="$(HOME)/.buildroot-ccache-saxon_default"

# Target options
BR2_riscv=y
BR2_RISCV_32=y

# Instruction Set Extensions
BR2_riscv_custom=y
BR2_RISCV_ISA_CUSTOM_RVM=y
BR2_RISCV_ISA_CUSTOM_RVA=y
BR2_RISCV_ISA_CUSTOM_RVC=n
BR2_RISCV_ABI_ILP32=y

# GCC
BR2_GCC_VERSION_8_X=y

# System
BR2_TARGET_GENERIC_GETTY=y
BR2_TARGET_GENERIC_GETTY_PORT="hvc0"

# Filesystem
BR2_TARGET_ROOTFS_CPIO=y

# Net
BR2_SYSTEM_DHCP=""

# Linux headers
BR2_PACKAGE_HOST_LINUX_HEADERS_CUSTOM_5_0=y

# Kernel
BR2_LINUX_KERNEL=y
BR2_LINUX_KERNEL_LATEST_VERSION=n
BR2_LINUX_KERNEL_CUSTOM_VERSION=y
BR2_LINUX_KERNEL_CUSTOM_VERSION_VALUE="5.0.9"
BR2_LINUX_KERNEL_USE_CUSTOM_CONFIG=y
BR2_LINUX_KERNEL_CUSTOM_CONFIG_FILE="board/spinal/saxon_ulx3s/linux.config"
BR2_LINUX_KERNEL_VMLINUX=y

# Rootfs customisation
BR2_ROOTFS_OVERLAY="board/spinal/saxon_ulx3s/rootfs_overlay"

# U-BOOT
BR2_PACKAGE_HOST_UBOOT_TOOLS=y
BR2_TARGET_ROOTFS_CPIO_UIMAGE=y

# Flashing
BR2_PACKAGE_MTD=y
BR2_PACKAGE_MTD_FLASH_ERASE=y
BR2_PACKAGE_MTD_TESTS=y
BR2_PACKAGE_MTD_FLASH_SPEED=y
BR2_PACKAGE_MTD_FLASH_TORTURE=y

# Extra packages
BR2_PACKAGE_DHRYSTONE=y
BR2_PACKAGE_MICROPYTHON=n
BR2_PACKAGE_PYTHON=n
BR2_PACKAGE_PYTHON_SPIDEV=n
BR2_PACKAGE_SL=y
BR2_PACKAGE_HELLO=n
BR2_PACKAGE_NANO=y
BR2_PACKAGE_SCREEN=y

BR2_PACKAGE_LMBENCH=n
BR2_PACKAGE_RAMSPEED=n
BR2_PACKAGE_STRESS_NG=n

BR2_GCC_CROSS_CXX=y
BR2_INSTALL_LIBSTDCPP=y
BR2_PACKAGE_IPERF=y
BR2_PACKAGE_IPERF3=y

BR2_PACKAGE_HTOP=y
BR2_PACKAGE_LYNX=n
BR2_PACKAGE_LINKS=n

BR2_PACKAGE_LIBATOMIC_OPS_ARCH_SUPPORTS=n
BR2_PACKAGE_LIBATOMIC_OPS=n
BR2_PACKAGE_OPENSSL=n
BR2_PACKAGE_LIBOPENSSL=n
BR2_PACKAGE_OPENSSH=n

BR2_PACKAGE_RNG_TOOLS=n
BR2_PACKAGE_HAVEGED=n

BR2_PACKAGE_DROPBEAR=y
BR2_PACKAGE_SSHPASS=y

#BR2_PACKAGE_BUSYBOX_SHOW_OTHERS=n
BR2_PACKAGE_BASH=n

BR2_PACKAGE_GIT=n

# Sound
BR2_USE_WCHAR=y
BR2_PACKAGE_ALSA_UTILS=y
BR2_PACKAGE_ALSA_UTILS_APLAY=y
BR2_PACKAGE_ALSA_UTILS_AMIXER=y
BR2_PACKAGE_ALSA_UTILS_ALSACONF=y
BR2_PACKAGE_ALSA_UTILS_SPEAKER_TEST=y
BR2_PACKAGE_ALSA_UTILS_ALSACTL=y
BR2_PACKAGE_ALSA_UTILS_BAT=y
BR2_PACKAGE_ALSA_LIB=y
BR2_PACKAGE_ALSA_LIB_PCM_PLUGINS=y

# Sound decoders
BR2_PACKAGE_MPG123=y
BR2_PACKAGE_MPV=n

# I2C
BR2_PACKAGE_BUSYBOX_SHOW_OTHERS=y
BR2_PACKAGE_I2C_TOOLS=y
```

## configs/spinal_vexriscv_sim_defconfig
```kconfig
# Target options
BR2_riscv=y
BR2_RISCV_32=y

# Instruction Set Extensions
BR2_CCACHE=y
BR2_CCACHE_DIR="$(HOME)/.buildroot-ccache-rv32ima"
BR2_riscv_custom=y
BR2_RISCV_ISA_CUSTOM_RVM=y
BR2_RISCV_ISA_CUSTOM_RVA=y
BR2_RISCV_ISA_CUSTOM_RVC=n
BR2_RISCV_ABI_ILP32=y

# System
# BR2_SYSTEM_DHCP="eth0"
BR2_TARGET_GENERIC_GETTY=y
BR2_TARGET_GENERIC_GETTY_PORT="hvc0"

# Filesystem
BR2_TARGET_ROOTFS_EXT2=y
BR2_TARGET_ROOTFS_AXFS=y
BR2_TARGET_ROOTFS_CPIO=y
BR2_TARGET_ROOTFS_CPIO_LZMA=y

# Linux headers same as kernel, a 4.20 series
BR2_PACKAGE_HOST_LINUX_HEADERS_CUSTOM_4_20=y

# Kernel
BR2_LINUX_KERNEL=y
BR2_LINUX_KERNEL_CUSTOM_VERSION=y
BR2_LINUX_KERNEL_CUSTOM_VERSION_VALUE="4.20.17"
BR2_LINUX_KERNEL_USE_CUSTOM_CONFIG=y
BR2_LINUX_KERNEL_CUSTOM_CONFIG_FILE="board/spinal/vexriscv_sim/linux.config"
BR2_LINUX_KERNEL_VMLINUX=y

# TOOLCHAIN
#BR2_TOOLCHAIN_USES_MUSL=y
#BR2_TOOLCHAIN_BUILDROOT_MUSL=y
#BR2_TOOLCHAIN_BUILDROOT_LIBC="musl"

#BR2_TOOLCHAIN_USES_NEWLIB=y


# User
BR2_PACKAGE_DHRYSTONE=y
BR2_PACKAGE_PYTHON=n
BR2_ROOTFS_OVERLAY="board/spinal/vexriscv_sim/overlay"
```

## configs/spinal_vexriscv_smp_defconfig
```kconfig
# Compilation cache
BR2_CCACHE=y
BR2_CCACHE_DIR="$(HOME)/.buildroot-ccache-vexriscv_sim_default"

# Target options
BR2_riscv=y
BR2_RISCV_32=y

# Instruction Set Extensions
BR2_riscv_custom=y
BR2_RISCV_ISA_CUSTOM_RVM=y
BR2_RISCV_ISA_CUSTOM_RVA=y
BR2_RISCV_ISA_CUSTOM_RVC=n
BR2_RISCV_ABI_ILP32=y

# GCC
BR2_GCC_VERSION_8_X=y

# System
BR2_TARGET_GENERIC_GETTY=y
BR2_TARGET_GENERIC_GETTY_PORT="hvc0"

# Filesystem
BR2_TARGET_ROOTFS_CPIO=y

# Net
BR2_SYSTEM_DHCP=""

BR2_TOOLCHAIN_EXTERNAL=y
BR2_TOOLCHAIN_EXTERNAL_CUSTOM=y
BR2_TOOLCHAIN_EXTERNAL_PREINSTALLED=y
BR2_TOOLCHAIN_EXTERNAL_PATH="/opt/riscv32ima"
BR2_TOOLCHAIN_EXTERNAL_CUSTOM_PREFIX="riscv32-unknown-linux-gnu"
BR2_TOOLCHAIN_EXTERNAL_GCC_8=y
BR2_TOOLCHAIN_EXTERNAL_CUSTOM_GLIBC=y
BR2_TOOLCHAIN_EXTERNAL_HEADERS_5_0=y
BR2_TOOLCHAIN_HEADERS_AT_LEAST="5.0"

# Linux headers
BR2_PACKAGE_HOST_LINUX_HEADERS_CUSTOM_5_4=y

# Kernel
BR2_LINUX_KERNEL=y
BR2_LINUX_KERNEL_LATEST_VERSION=n
BR2_LINUX_KERNEL_CUSTOM_VERSION=y
BR2_LINUX_KERNEL_CUSTOM_VERSION_VALUE="5.6"
BR2_LINUX_KERNEL_USE_CUSTOM_CONFIG=y
BR2_LINUX_KERNEL_CUSTOM_CONFIG_FILE="board/spinal/vexriscv/smp/linux.config"
BR2_LINUX_KERNEL_VMLINUX=y

# Rootfs customisation
BR2_ROOTFS_OVERLAY="board/spinal/vexriscv/smp/rootfs_overlay"

# U-BOOT
BR2_PACKAGE_HOST_UBOOT_TOOLS=y
BR2_TARGET_ROOTFS_CPIO_UIMAGE=y

# Extra packages
BR2_PACKAGE_DHRYSTONE=y
BR2_PACKAGE_HTOP=y

BR2_PACKAGE_LMBENCH=n
BR2_PACKAGE_RAMSPEED=n
BR2_PACKAGE_NANO=n
```
